#include <stdio.h>
#include "freertos/FreeRTOS.h"
#include "freertos/task.h"
#include "freertos/event_groups.h"
#include "esp_event.h"
#include "nvs_flash.h"
#include "esp_log.h"
#include "esp_nimble_hci.h"
#include "nimble/nimble_port.h"
#include "nimble/nimble_port_freertos.h"
#include "host/ble_hs.h"
#include "services/gap/ble_svc_gap.h"
#include "services/gatt/ble_svc_gatt.h"
#include "sdkconfig.h"
#include "esp_system.h"  // Include for GPIO control
#include "driver/gpio.h" // Include for GPIO control
#include <esp32c2/rom/gpio.h>



char *TAG = "BLE-Server";
uint8_t ble_addr_type;

char blesend[50];
char blerec[50];
void ble_app_advertise(void);

// GPIO Configuration
#define GPIO_OUTPUT_PIN GPIO_NUM_1 // Change this to the GPIO pin you want to control
void gpio_init(){
    // Add GPIO initialization here
    gpio_config_t io_conf = {
        .pin_bit_mask = (1ULL << GPIO_OUTPUT_PIN),
        .mode = GPIO_MODE_OUTPUT,
        .intr_type = GPIO_INTR_DISABLE,
        .pull_up_en = 0,
        .pull_down_en = 0,
    };
    gpio_config(&io_conf);
}

// Call Back Registered with BLE GATT Layer to handle write operations (Client to Server)
static int device_write(uint16_t conn_handle, uint16_t attr_handle, struct ble_gatt_access_ctxt *ctxt, void *arg)
{
    
    printf("Data from the client: %.*s\n", ctxt->om->om_len, ctxt->om->om_data);
    memcpy(&blerec, ctxt->om->om_data, sizeof(char));

    // Check if the length of ctxt->om->om_data is greater than or equal to 5
    if (strlen((char *)ctxt->om->om_data) >= 5) {
    // Copy the relevant portion of ctxt->om->om_data starting from the 5th character into blesend
        strcpy(blerec, (char *)(ctxt->om->om_data) + 5);
        printf("blesend after shift: %s\n", blerec);
    }
    
    esp_err_t err; // For Error Log
    // Perform GPIO control based on the received value
    if (strcmp(blerec, "123") == 0) {
            err = gpio_set_level(GPIO_OUTPUT_PIN, 0);
            if (err != ESP_OK) {
            ESP_LOGE(TAG, "Failed to set GPIO level to 0. Error code: %d", err);
            }

    } else if (strcmp(blerec, "124") == 0) {
        err = gpio_set_level(GPIO_OUTPUT_PIN, 1);
        if (err != ESP_OK) { 
        ESP_LOGE(TAG, "Failed to set GPIO level to 1. Error code: %d", err);
        }

    } else {
    // Default case
    }
    return 0;
}

// Call Back Registered with BLE GATT Layer to handle Read operations (Server to Client)
static int device_read(uint16_t con_handle, uint16_t attr_handle, struct ble_gatt_access_ctxt *ctxt, void *arg)
{
    os_mbuf_append(ctxt->om, blesend, strlen(blesend));
    return 0;
}
 
// BLE event handling for Events generated by BLE GAP Layer
static int ble_gap_event(struct ble_gap_event *event, void *arg)
{ 
    switch (event->type)
    {
    // Advertise if connected
    case BLE_GAP_EVENT_CONNECT:
        ESP_LOGI("GAP", "BLE GAP EVENT CONNECT %s", event->connect.status == 0 ? "OK!" : "FAILED!");
        if (event->connect.status != 0)
        {
            ble_app_advertise();
        }
        break;
// Advertise if connected
   case BLE_GAP_EVENT_DISCONNECT:
	   ESP_LOGI("GAP", "BLE GAP EVENT DISCONNECTED %s", event->connect.status == 1 ? "OK!" : "DISCONNECTED!");
	   if (event->connect.status != 1)
	   {
		   ble_app_advertise();
	   }
	   break;
    // Advertise again after completion of the event
    case BLE_GAP_EVENT_ADV_COMPLETE:
        ESP_LOGI("GAP", "BLE GAP EVENT");
        ble_app_advertise();
        break;
    default:
        break;
    }
    return 0;
}

// Define the BLE connection
void ble_app_advertise(void)
{
    // GAP - device name definition
    struct ble_hs_adv_fields fields;
    const char *device_name;
    memset(&fields, 0, sizeof(fields));
    device_name = ble_svc_gap_device_name(); // Read the BLE device name
    fields.name = (uint8_t *)device_name;
    fields.name_len = strlen(device_name);
    fields.name_is_complete = 1;
    ble_gap_adv_set_fields(&fields);

    // GAP - device connectivity definition
    struct ble_gap_adv_params adv_params;
    memset(&adv_params, 0, sizeof(adv_params));
    adv_params.conn_mode = BLE_GAP_CONN_MODE_UND; // connectable or non-connectable
    adv_params.disc_mode = BLE_GAP_DISC_MODE_GEN; // discoverable or non-discoverable
    ble_gap_adv_start(ble_addr_type, NULL, BLE_HS_FOREVER, &adv_params, ble_gap_event, NULL);
}

//  Bluetooth Low Energy (BLE) GATT service Definition
static const struct ble_gatt_svc_def gatt_svcs[] = {
    {.type = BLE_GATT_SVC_TYPE_PRIMARY,
     .uuid = BLE_UUID128_DECLARE(0x12, 0x34, 0xAB, 0xCD, 0xEF, 0x01, 0x23, 0x45, 0x67, 0x89, 0xAB, 0xCD, 0xEF, 0x01, 0x23, 0x45),  // Define UUID 16bit for device type
     //.uuid = BLE_UUID16_DECLARE(0x180),   // Define UUID 16bit for device type
     .characteristics = (struct ble_gatt_chr_def[]){
         {.uuid = BLE_UUID16_DECLARE(0xFEF4),           // Define UUID for reading # 1 (Server to Client)
          .flags = BLE_GATT_CHR_F_READ,
          .access_cb = device_read},
         {.uuid = BLE_UUID16_DECLARE(0xABCD),           // Define UUID for reading # 2  (Server to Client)
          .flags = BLE_GATT_CHR_F_READ,
          .access_cb = device_read},          
         {.uuid = BLE_UUID16_DECLARE(0xDEAD),           // Define UUID for writing (Client to Server)
          .flags = BLE_GATT_CHR_F_WRITE,
          .access_cb = device_write},
         {0}}},
    {0}};

//  Callback that gets executed when the BLE stack is synchronized
//  This typically happens during the initialization process or when the BLE stack is ready to operate.
void ble_app_on_sync(void)
{
    ble_hs_id_infer_auto(0, &ble_addr_type); // Determines the best address type automatically
    ble_app_advertise();                     // Define the BLE connection
}

//  The infinite task
//  Function represents a FreeRTOS task responsible for running the NimBLE host stack.
void host_task(void *param)
{
    nimble_port_run(); // This function will return only when nimble_port_stop() is executed
}

void app_main()
{
    gpio_init();
    nvs_flash_init();                          // 1 - Initialize NVS flash using
    esp_nimble_hci_init();                     // 2 - Initialize ESP controller
    nimble_port_init();                        // 3 - Initialize the host stack
    ble_svc_gap_device_name_set("BLE-Server"); // 4 - Initialize NimBLE configuration - server name
    ble_svc_gap_init();                        // 4 - Initialize NimBLE configuration - gap service
    ble_svc_gatt_init();                       // 4 - Initialize NimBLE configuration - gatt service
    ble_gatts_count_cfg(gatt_svcs);            // 4 - Initialize NimBLE configuration - config gatt services
    ble_gatts_add_svcs(gatt_svcs);             // 4 - Initialize NimBLE configuration - queues gatt services.
    ble_hs_cfg.sync_cb = ble_app_on_sync;      // 5 - Initialize application
    nimble_port_freertos_init(host_task);      // 6 - Run the thread


int num = 1000;
    while(1){
  
    	num = num +1;
    	itoa( num, blesend, 10) ;

    	vTaskDelay(1000 / portTICK_PERIOD_MS);
    }
}