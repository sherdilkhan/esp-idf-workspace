## Projects/esp32s3_bme280/components/i2cdev/Kconfig
```kconfig
menu "I2C"

config I2CDEV_TIMEOUT
    int "I2C transaction timeout, milliseconds"
    default 1000
    range 10 5000
    
config I2CDEV_NOLOCK
	bool "Disable the use of mutexes"
	default n
	help
		Attention! After enabling this option, all I2C device
		drivers will become non-thread safe. 
		Use this option if you need to access your I2C devices
		from interrupt handlers. 
		
config EXAMPLE_I2C_MASTER_SCL
        int "SCL GPIO Number"
        default 5 if IDF_TARGET_ESP8266
        default 6 if IDF_TARGET_ESP32C3
        default 19 if IDF_TARGET_ESP32 || IDF_TARGET_ESP32S2 || IDF_TARGET_ESP32S3
        default 4 if IDF_TARGET_ESP32H2
        help
            GPIO number for I2C Master clock line.

config EXAMPLE_I2C_MASTER_SDA
        int "SDA GPIO Number"
        default 4 if IDF_TARGET_ESP8266
        default 5 if IDF_TARGET_ESP32C3
        default 18 if IDF_TARGET_ESP32 || IDF_TARGET_ESP32S2 || IDF_TARGET_ESP32S3
        default 3 if IDF_TARGET_ESP32H2
        help
            GPIO number for I2C Master data line.

    
endmenu
```

## Projects/esp32s3_sample/components/led_strip/Kconfig
```kconfig
menu "LED Configuration"
    orsource "$IDF_PATH/examples/common_components/env_caps/$IDF_TARGET/Kconfig.env_caps"
    config LED_GPIO
        int "LED GPIO"
        default 15
        help
            GPIO on on which LED is connected
endmenu
```

## SIMS_IOT_DEVICES/wifi_config/main/Kconfig.projbuild
```kconfig
# put here your custom config value
menu "Example Configuration"
config ESP_WIFI_SSID
    string "WiFi SSID"
    default "sherdil"
    help
	SSID (network name) for the example to connect to.

config ESP_WIFI_PASSWORD
    string "WiFi Password"
    default "112233445566"
    help
	WiFi password (WPA or WPA2) for the example to use.
endmenu
```
